## yocto/meta-ipmi-driver-test/conf/layer.conf
```bitbake
# We have a conf and classes directory, add to BBPATH
BBPATH .= ":${LAYERDIR}"

# We have recipes-* directories, add to BBFILES
BBFILES += "${LAYERDIR}/recipes-*/*/*.bb \
            ${LAYERDIR}/recipes-*/*/*.bbappend"

BBFILE_COLLECTIONS += "ipmidrivertest"
BBFILE_PATTERN_ipmidrivertest = "^${LAYERDIR}/"
BBFILE_PRIORITY_ipmidrivertest = "5"
LAYERVERSION_ipmidrivertest = "4"
LAYERSERIES_COMPAT_ipmidrivertest = "scarthgap"
```
